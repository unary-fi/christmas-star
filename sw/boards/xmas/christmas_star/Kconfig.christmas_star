## sw/boards/xmas/christmas_star/Kconfig.christmas_star
```kconfig
# Copyright (c) 2024-2026 Tuomas Terho
# SPDX-License-Identifier: MIT

config BOARD_CHRISTMAS_STAR
	select SOC_STM32F030XC
```

## sw/boards/xmas/christmas_star/board.yml
```yaml
board:
  name: christmas_star
  full_name: Christmas Star 1.0
  vendor: xmas
  socs:
    - name: stm32f030xc
```

## sw/boards/xmas/christmas_star/christmas_star_defconfig
```kconfig
# Copyright (c) 2024-2026 Tuomas Terho
# SPDX-License-Identifier: MIT


CONFIG_SERIAL=y
CONFIG_UART_INTERRUPT_DRIVEN=y
CONFIG_GPIO=y
CONFIG_PINCTRL=y
```

## sw/tests/unit/testcase.yaml
```yaml
tests:
  star.unit:
    platform_allow:
      - qemu_cortex_m3
      - native_sim
    integration_platforms:
      - qemu_cortex_m3
    tags: star
```
