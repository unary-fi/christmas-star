## CMakeLists.txt
```
# Copyright (c) 2024-2026 Tuomas Terho
# SPDX-License-Identifier: MIT
#
# Unit tests for the hardware-independent firmware modules.
#   west build -b qemu_cortex_m3 sw/tests/unit -d build/tests -t run
# or with twister:
#   west twister -T sw/tests -p qemu_cortex_m3

cmake_minimum_required(VERSION 3.20.0)
find_package(Zephyr REQUIRED HINTS $ENV{ZEPHYR_BASE})
project(star_unit_tests)

set(APP ${CMAKE_CURRENT_SOURCE_DIR}/../../src)

target_include_directories(app PRIVATE ${APP})
target_sources(app PRIVATE
	src/test_layout.c
	src/test_parse.c
	src/test_xmodem.c
	src/test_format.c
	src/test_effects.c
	src/test_stream.c
	src/test_supply.c
	src/test_pair.c
	src/test_fw.c
	src/test_comet.c
	src/stubs.c
	${APP}/layout/led_layout.c
	${APP}/layout/led_layout_table.c
	${APP}/led/color.c
	${APP}/led/led_limit.c
	${APP}/cli/direct_parse.c
	${APP}/transfer/xmodem.c
	${APP}/storage/effect_format.c
	${APP}/effects/fx_basic.c
	${APP}/effects/fx_golden.c
	${APP}/effects/fx_xmas.c
	${APP}/effects/fx_xmas2.c
	${APP}/effects/shake_overlay.c
	${APP}/transfer/stream_frame.c
	${APP}/pair/sha256.c
	${APP}/pair/pair_logic.c
	${APP}/bt/bm78_ad.c
	${APP}/fw/fw_image.c
	${APP}/game/comet_logic.c
)
```

## Kconfig
```
# Settings referenced by the modules under test.

config STAR_DEFAULT_SHAKE_THRESHOLD_MG
	int
	default 600

source "Kconfig.zephyr"
```

## prj.conf
```kconfig
CONFIG_ZTEST=y
CONFIG_ZTEST_STACK_SIZE=2048
CONFIG_CRC=y
```

## src/stubs.c
```c
/*
 * Copyright (c) 2024-2026 Tuomas Terho
 * SPDX-License-Identifier: MIT
 *
 * Stubs for hardware modules referenced by the code under test.
 */

#include "imu/lsm6ds.h"

uint16_t imu_get_shake_threshold(void)
{
	return CONFIG_STAR_DEFAULT_SHAKE_THRESHOLD_MG;
}
```

## src/test_comet.c
```c
/*
 * Copyright (c) 2024-2026 Tuomas Terho
 * SPDX-License-Identifier: MIT
 */

#include <stdlib.h>
#include <string.h>
#include <zephyr/ztest.h>

#include "game/comet_logic.h"
#include "layout/led_layout.h"

static struct comet_graph g;

static uint8_t outline(uint8_t step)
{
	for (uint8_t i = 0; i < LED_FACE_COUNT; i++) {
		if (led_layout[i].group == LED_GROUP_OUTLINE && led_layout[i].step == step % 48) {
			return i;
		}
	}
	return COMET_NONE;
}

static uint8_t partner(uint8_t n)
{
	return led_layout[n].partner;
}

static bool linked(uint8_t a, uint8_t b)
{
	for (int k = 0; k < g.deg[a]; k++) {
		if (g.nb[a][k] == b) {
			return true;
		}
	}
	return false;
}

/* The neighbour of a node of the given kind (the first one). */
static uint8_t neighbour(uint8_t n, uint8_t kind, uint8_t skip)
{
	for (int k = 0; k < g.deg[n]; k++) {
		if (g.kind[g.nb[n][k]] == kind && g.nb[n][k] != skip) {
			return g.nb[n][k];
		}
	}
	return COMET_NONE;
}

/* Clockwise in the front view going from a to b. */
static bool clockwise(uint8_t a, uint8_t b)
{
	const struct led_info *L = led_layout;

	return L[a].x * (L[b].y - L[a].y) - L[a].y * (L[b].x - L[a].x) < 0;
}

static void *setup(void)
{
	comet_graph_build(&g, led_layout);
	return NULL;
}

/* Run the countdown, then play. */
static void start(struct comet_game *s, uint8_t mode, uint32_t seed)
{
	comet_reset(s, &g, mode, seed);
	for (int i = 0; i < COMET_COUNTDOWN_MS / 100; i++) {
		comet_tick(s, &g, 100);
	}
	zassert_equal(s->state, COMET_PLAY);
}

/* Advance until the head moves one step (or the game ends). */
static void step_once(struct comet_game *s)
{
	uint8_t head_i = s->head_i;

	for (int i = 0; i < 1000 && s->head_i == head_i && s->state == COMET_PLAY; i++) {
		comet_tick(s, &g, 10);
	}
}

/* Keep sparks out of the way of a test. */
static void no_items(struct comet_game *s)
{
	s->spark = COMET_NONE;
	s->bonus = COMET_NONE;
}

ZTEST(comet, test_graph)
{
	for (int face = 0; face < 2; face++) {
		int junctions = 0, kinds[3] = {0};

		for (int i = face * LED_FACE_COUNT; i < (face + 1) * LED_FACE_COUNT; i++) {
			zassert_true(g.deg[i] == 2 || g.deg[i] == 3, "node %d deg %d", i, g.deg[i]);
			junctions += g.deg[i] == 3;
			kinds[g.kind[i]]++;
			for (int k = 0; k < g.deg[i]; k++) {
				uint8_t n = g.nb[i][k];

				zassert_true(linked(n, (uint8_t)i), "edge %d-%d one way", i, n);
				zassert_equal(n / LED_FACE_COUNT, face, "edge %d-%d crosses faces", i, n);
			}
		}
		zassert_equal(kinds[COMET_OUTLINE], 48);
		zassert_equal(kinds[COMET_CIRCLE], 12);
		zassert_equal(kinds[COMET_PASSAGE], 6);
		/* Concave vertices, passages and every circle LED. */
		zassert_equal(junctions, 6 + 6 + 12, "face %d: %d junctions", face, junctions);
	}
	/* Each passage: one concave vertex outside, two neighbouring circle LEDs inside. */
	for (int o = 0; o < 48; o += 8) {
		uint8_t v = outline((uint8_t)o);
		uint8_t p = neighbour(v, COMET_PASSAGE, COMET_NONE);

		zassert_not_equal(p, COMET_NONE);
		zassert_equal(g.deg[p], 3);
		uint8_t c1 = neighbour(p, COMET_CIRCLE, COMET_NONE);
		uint8_t c2 = neighbour(p, COMET_CIRCLE, c1);

		zassert_not_equal(c2, COMET_NONE);
		zassert_true(linked(c1, c2), "the circle runs under the passage");
		zassert_equal(neighbour(p, COMET_OUTLINE, COMET_NONE), v);
	}
	/* The circle is closed: walking along it comes back after 12 steps. */
	uint8_t first = neighbour(neighbour(outline(0), COMET_PASSAGE, COMET_NONE), COMET_CIRCLE,
				  COMET_NONE);
	uint8_t prev = first, cur = neighbour(first, COMET_CIRCLE, COMET_NONE);
	int n = 1;

	while (cur != first && n < 20) {
		uint8_t nx = neighbour(cur, COMET_CIRCLE, prev);

		prev = cur;
		cur = nx;
		n++;
	}
	zassert_equal(n, 12);
	/* The back is the same track through the partners. */
	for (int i = 0; i < LED_FACE_COUNT; i++) {
		zassert_equal(g.deg[partner(i)], g.deg[i]);
		zassert_equal(g.kind[partner(i)], g.kind[i]);
		for (int k = 0; k < g.deg[i]; k++) {
			zassert_true(linked(partner(i), partner(g.nb[i][k])));
		}
	}
}

ZTEST(comet, test_back_shows_front_unmirrored)
{
	const struct led_info *L = led_layout;
	int on_axis = 0;

	for (int i = 0; i < LED_FACE_COUNT; i++) {
		uint8_t m = g.mirror[i];

		zassert_true(m < LED_FACE_COUNT);
		zassert_equal(g.mirror[m], i, "mirroring twice gives the LED back");
		zassert_true(abs(L[m].x + L[i].x) <= 1 && abs(L[m].y - L[i].y) <= 1,
			     "LED %d (%d,%d) -> %d (%d,%d)", i, L[i].x, L[i].y, m, L[m].x, L[m].y);
		zassert_equal(g.kind[m], g.kind[i], "the mirror image is the same track");
		on_axis += m == i;
	}
	/* Only the top and bottom tips sit on the vertical axis. */
	zassert_equal(on_axis, 2);
	/*
	 * A viewer behind the star sees back LED partner[i] where a viewer in
	 * front sees front LED mirror[i]: same picture, so a left turn on the
	 * front is a left turn on the back too.
	 */
	for (int i = 0; i < LED_FACE_COUNT; i++) {
		uint8_t back = partner(i);

		zassert_equal(L[back].x, L[i].x, "partner at the same place");
	}
}

ZTEST(comet, test_outer_junction)
{
	/* Clockwise along the outline into a concave vertex: the centre is on the right. */
	uint8_t from = outline(7), v = outline(8), line = outline(9);
	uint8_t p = neighbour(v, COMET_PASSAGE, COMET_NONE);
	bool used;

	zassert_equal(comet_choose(&g, from, v, COMET_CW, 0, &used), line);
	zassert_false(used);
	zassert_equal(comet_choose(&g, from, v, COMET_CW, COMET_RIGHT, &used), p);
	zassert_true(used);
	/* No left turn off the line here: follow it, the tap is not used. */
	zassert_equal(comet_choose(&g, from, v, COMET_CW, COMET_LEFT, &used), line);
	zassert_false(used);

	/* Seen from behind, the same move is mirrored: the passage is on the left. */
	zassert_equal(comet_choose(&g, partner(from), partner(v), COMET_CW, COMET_LEFT, &used),
		      partner(p));
	zassert_true(used);
	zassert_equal(comet_choose(&g, partner(from), partner(v), COMET_CW, COMET_RIGHT, &used),
		      partner(line));
	zassert_false(used);
}

ZTEST(comet, test_passage)
{
	uint8_t v = outline(8);
	uint8_t p = neighbour(v, COMET_PASSAGE, COMET_NONE);
	uint8_t c1 = neighbour(p, COMET_CIRCLE, COMET_NONE);
	uint8_t c2 = neighbour(p, COMET_CIRCLE, c1);
	uint8_t cw = clockwise(p, c1) ? c1 : c2;
	uint8_t ccw = cw == c1 ? c2 : c1;
	bool used;

	/* Down the passage: the comet keeps its direction of travel ... */
	zassert_equal(comet_choose(&g, v, p, COMET_CW, 0, &used), cw);
	zassert_false(used);
	zassert_equal(comet_choose(&g, v, p, COMET_CCW, 0, NULL), ccw);
	/* ... or goes the way of a tap, whichever side. */
	uint8_t l = comet_choose(&g, v, p, COMET_CW, COMET_LEFT, &used);

	zassert_true(used);
	uint8_t r = comet_choose(&g, v, p, COMET_CW, COMET_RIGHT, &used);

	zassert_true(used);
	zassert_not_equal(l, r);
	zassert_true((l == c1 && r == c2) || (l == c2 && r == c1));

	/* Onto the circle: on round it, not back under the passage. */
	uint8_t on = comet_choose(&g, p, cw, COMET_CW, 0, NULL);

	zassert_equal(g.kind[on], COMET_CIRCLE);
	zassert_not_equal(on, ccw);
	zassert_false(linked(on, p));

	/* From the circle into the passage: straight out to the outline. */
	zassert_equal(comet_choose(&g, c1, p, COMET_CW, COMET_LEFT, NULL), v);
	zassert_equal(comet_choose(&g, c2, p, COMET_CCW, COMET_RIGHT, NULL), v);

	/* Along the circle past a passage: follow the circle unless turning out. */
	uint8_t before = neighbour(c1, COMET_CIRCLE, c2);
	struct comet_exits e;

	comet_exits_at(&g, before, c1, COMET_CW, &e);
	zassert_equal(e.dflt, c2);
	zassert_equal(e.alt, p);
	zassert_false(e.fork);
	zassert_equal(comet_choose(&g, before, c1, COMET_CW, e.alt_side, &used), p);
	zassert_true(used);
	zassert_equal(comet_choose(&g, before, c1, COMET_CW, 3 - e.alt_side, &used), c2);
	zassert_false(used);
}

ZTEST(comet, test_turn_at_next_junction)
{
	struct comet_game s;
	bool armed;

	start(&s, COMET_SINGLE, 1);
	no_items(&s);
	/* Starts at the top tip (outline 4) going clockwise; the next place to turn is outline 8. */
	zassert_equal(comet_head(&s), outline(4));
	uint8_t p = neighbour(outline(8), COMET_PASSAGE, COMET_NONE);

	zassert_equal(comet_next_turn(&s, &g, &armed), p, "shows the way in");
	zassert_false(armed);
	comet_input(&s, &g, COMET_RIGHT);
	zassert_equal(s.armed, COMET_RIGHT);
	zassert_equal(comet_next_turn(&s, &g, &armed), p);
	zassert_true(armed);
	while (comet_head(&s) != outline(8)) {
		step_once(&s);
		zassert_equal(s.state, COMET_PLAY);
	}
	zassert_equal(s.next, p);
	zassert_equal(s.armed, 0, "used at the junction");
	/* At the end of the passage it turns right again: the latest tap. */
	step_once(&s);
	zassert_equal(comet_head(&s), p);
	struct comet_exits e;

	comet_exits_at(&g, outline(8), p, s.rot, &e);
	zassert_true(e.fork);
	zassert_equal(s.next, e.alt_side == COMET_RIGHT ? e.alt : e.dflt, "turns right");

	/* Without any tap yet, the end of a passage keeps the direction of travel. */
	start(&s, COMET_SINGLE, 1);
	no_items(&s);
	while (comet_head(&s) != outline(7)) {
		step_once(&s);
	}
	s.next = outline(8);
	s.from = outline(6);
	while (comet_head(&s) != outline(8)) {
		step_once(&s);
	}
	s.next = p; /* into the passage without a tap */
	step_once(&s);
	zassert_equal(comet_head(&s), p);
	zassert_true(clockwise(p, s.next));

	/* A left tap there is dropped: no left turn off the line. */
	start(&s, COMET_SINGLE, 1);
	no_items(&s);
	comet_input(&s, &g, COMET_LEFT);
	zassert_equal(comet_next_turn(&s, &g, &armed), p);
	zassert_false(armed);
	while (comet_head(&s) != outline(8)) {
		step_once(&s);
	}
	zassert_equal(s.next, outline(9));
	zassert_equal(s.armed, 0, "dropped at the junction");
}

ZTEST(comet, test_flip)
{
	struct comet_game s;

	start(&s, COMET_DOUBLE, 2);
	no_items(&s);
	step_once(&s);
	uint8_t head = comet_head(&s), next = s.next;

	comet_input(&s, &g, COMET_FLIP);
	step_once(&s);
	zassert_equal(comet_head(&s), partner(head), "through the star");
	zassert_equal(s.next, partner(next), "same direction on the other side");
	zassert_true(comet_head(&s) >= LED_FACE_COUNT);
	step_once(&s);
	zassert_equal(comet_head(&s), partner(next));

	/* Flipping onto the tail ends the game. */
	start(&s, COMET_DOUBLE, 3);
	no_items(&s);
	head = comet_head(&s);
	s.body[(uint8_t)(s.head_i - 1) % COMET_RING] = partner(head);
	comet_input(&s, &g, COMET_FLIP);
	step_once(&s);
	zassert_equal(s.state, COMET_OVER);

	/* One-sided games ignore flips. */
	start(&s, COMET_SINGLE, 4);
	no_items(&s);
	comet_input(&s, &g, COMET_FLIP);
	zassert_false(s.flip);
	step_once(&s);
	zassert_true(comet_head(&s) < LED_FACE_COUNT);
}

ZTEST(comet, test_sparks_and_growth)
{
	struct comet_game s;
	bool back = false;

	for (uint32_t seed = 1; seed < 200; seed++) {
		comet_reset(&s, &g, COMET_SINGLE, seed);
		zassert_true(s.spark < LED_FACE_COUNT, "front only");
		zassert_false(comet_on_body(&s, s.spark));
		comet_reset(&s, &g, COMET_DOUBLE, seed);
		zassert_false(comet_on_body(&s, s.spark));
		back |= s.spark >= LED_FACE_COUNT;
	}
	zassert_true(back, "double-sided sparks appear on the back too");

	start(&s, COMET_SINGLE, 5);
	s.bonus = COMET_NONE;
	s.spark = s.next;
	step_once(&s);
	zassert_equal(s.score, 1);
	zassert_equal(s.grow, 2);
	zassert_not_equal(s.spark, COMET_NONE);
	zassert_false(comet_on_body(&s, s.spark));
	step_once(&s);
	step_once(&s);
	zassert_equal(s.len, COMET_START_LEN + 2);

	/* Double-sided sparks count twice. */
	start(&s, COMET_DOUBLE, 6);
	s.bonus = COMET_NONE;
	s.spark = s.next;
	step_once(&s);
	zassert_equal(s.score, 2);
}

ZTEST(comet, test_levels_and_tail)
{
	struct comet_game s;

	zassert_equal(comet_speed(1), COMET_SPEED_START);
	zassert_equal(comet_speed(2), COMET_SPEED_START + 1);
	zassert_equal(comet_speed(100), COMET_SPEED_MAX);

	start(&s, COMET_SINGLE, 7);
	for (int i = 0; i < COMET_SPARKS_PER_LEVEL; i++) {
		s.bonus = COMET_NONE;
		s.spark = s.next;
		step_once(&s);
	}
	zassert_equal(s.level, 2);

	/* Running into the tail ends the game. */
	start(&s, COMET_SINGLE, 8);
	no_items(&s);
	s.body[(uint8_t)(s.head_i - 1) % COMET_RING] = s.next;
	s.len = 3;
	s.grow = 0;
	step_once(&s);
	zassert_equal(s.state, COMET_OVER);
}

ZTEST(comet, test_replay)
{
	struct comet_game a, b;
	static const uint8_t inputs[] = {COMET_RIGHT, COMET_LEFT, COMET_FLIP, COMET_RIGHT, COMET_FLIP};

	start(&a, COMET_DOUBLE, 1234);
	start(&b, COMET_DOUBLE, 1234);
	for (int t = 0; t < 60000 && a.state == COMET_PLAY; t += 20) {
		if (t % 700 == 0) {
			uint8_t in = inputs[(t / 700) % ARRAY_SIZE(inputs)];

			comet_input(&a, &g, in);
			comet_input(&b, &g, in);
		}
		comet_tick(&a, &g, 20);
		comet_tick(&b, &g, 20);
	}
	zassert_mem_equal(&a, &b, sizeof(a));
}

ZTEST(comet, test_pause)
{
	struct comet_game s;

	start(&s, COMET_SINGLE, 9);
	uint8_t head = comet_head(&s);

	comet_pause(&s, true);
	zassert_equal(s.state, COMET_PAUSED);
	for (int i = 0; i < 50; i++) {
		comet_tick(&s, &g, 100);
	}
	zassert_equal(comet_head(&s), head);
	comet_pause(&s, false);
	zassert_equal(s.state, COMET_COUNTDOWN, "resume counts down first");
}

ZTEST_SUITE(comet, NULL, setup, NULL, NULL, NULL);
```

## src/test_effects.c
```c
/*
 * Copyright (c) 2024-2026 Tuomas Terho
 * SPDX-License-Identifier: MIT
 */

#include <string.h>
#include <zephyr/ztest.h>

#include "effects/effect.h"
#include "effects/shake_overlay.h"

static struct led_rgb frame[LED_COUNT];
static struct led_rgb out[LED_COUNT];

static int dark_count(const struct led_rgb *f)
{
	int n = 0;

	for (int i = 0; i < LED_FACE_COUNT; i++) {
		if (f[i].r + f[i].g + f[i].b < 30) {
			n++;
		}
	}
	return n;
}

static void assert_faces_match(const struct led_rgb *f)
{
	for (int i = 0; i < LED_FACE_COUNT; i++) {
		const struct led_rgb *a = &f[i];
		const struct led_rgb *b = &f[led_layout[i].partner];

		zassert_true(a->r == b->r && a->g == b->g && a->b == b->b, "LED %d", i);
	}
}

ZTEST_SUITE(effects, NULL, NULL, NULL, NULL, NULL);

ZTEST(effects, test_shake_drops_and_regrows_any_colour)
{
	/* Upright star at rest: the accelerometer reads +1 g along board +y. */
	struct imu_state calm = {.ok = true, .gy = 1000, .ay = 1000, .shake = 0};
	struct imu_state shake = calm;
	struct led_rgb teal = {.r = 0, .g = 180, .b = 160};
	uint32_t t = 1000;

	shake.shake = 2000;
	shake.ax = 1500;

	shake_set_enabled(true);
	for (int i = 0; i < LED_COUNT; i++) {
		frame[i] = teal;
	}

	/* Shake for half a second. The effect frame must never change. */
	for (int i = 0; i < 25; i++) {
		t += 20;
		memcpy(out, frame, sizeof(out));
		shake_overlay_apply(out, t, &shake);
		assert_faces_match(out);
	}
	for (int i = 0; i < 10; i++) {
		t += 20;
		memcpy(out, frame, sizeof(out));
		shake_overlay_apply(out, t, &calm);
	}
	zassert_true(dark_count(out) > 0, "shaking knocks lights off");
	for (int i = 0; i < LED_COUNT; i++) {
		zassert_true(frame[i].g == teal.g, "effect frame untouched");
	}

	/* After a long calm period everything has grown back. */
	for (int i = 0; i < 400; i++) {
		t += 20;
		memcpy(out, frame, sizeof(out));
		shake_overlay_apply(out, t, &calm);
	}
	zassert_equal(dark_count(out), 0, "lights grow back");
	zassert_mem_equal(out, frame, sizeof(out), "no overlay left");
}

ZTEST(effects, test_shake_disabled_is_transparent)
{
	struct imu_state shake = {.ok = true, .gy = 1000, .shake = 3000, .ax = 2000};

	for (int i = 0; i < LED_COUNT; i++) {
		frame[i] = (struct led_rgb){.r = 200, .g = 10, .b = 10};
	}
	shake_set_enabled(false);
	for (int i = 0; i < 30; i++) {
		memcpy(out, frame, sizeof(out));
		shake_overlay_apply(out, 2000U + (uint32_t)i * 20U, &shake);
	}
	zassert_mem_equal(out, frame, sizeof(out));
	shake_set_enabled(true);
}

static uint32_t state_a[FX_STATE_MAX / 4];
static uint32_t state_b[FX_STATE_MAX / 4];

static void run(const struct effect *fx, struct led_rgb *f, void *state, uint32_t from,
		uint32_t to, const struct imu_state *imu)
{
	for (uint32_t t = from; t < to; t += 20) {
		fx->render(f, t, imu, state);
	}
}

ZTEST(effects, test_all_effects_render)
{
	struct imu_state imu = {.ok = true, .gy = 1000, .ay = 1000};
	int listed = 0;

	/* Every effect compiled into the tests (the engine's list minus the player). */
	static const struct effect *const all[] = {
		&fx_golden, &fx_liquidgold, &fx_snowfall, &fx_shootingstars, &fx_candle,
		&fx_hearthfrost, &fx_aurora, &fx_candycane, &fx_treelights, &fx_bethlehem,
		&fx_fireworks, &fx_disco, &fx_frost, &fx_twinkle, &fx_comet, &fx_rainbow,
		&fx_solid, &fx_off, &fx_manual, &fx_test,
	};

	for (size_t e = 0; e < ARRAY_SIZE(all); e++) {
		const struct effect *fx = all[e];
		uint32_t lit = 0;

		zassert_true(fx->help != NULL && fx->name != NULL);
		zassert_true(fx->state_size <= FX_STATE_MAX, "%s state", fx->name);
		if (fx->flags & FX_HIDDEN) {
			continue;
		}
		listed++;
		zassert_true(fx->title != NULL && fx->subtitle != NULL, "%s has a title", fx->name);
		memset(frame, 0, sizeof(frame));
		memset(state_a, 0, sizeof(state_a));
		if (fx->start != NULL) {
			fx->start(frame, state_a);
		}
		for (uint32_t t = 0; t < 6000; t += 20) {
			fx->render(frame, t, &imu, state_a);
			for (int i = 0; i < LED_COUNT; i++) {
				lit += (frame[i].r + frame[i].g + frame[i].b) > 0;
			}
		}
		zassert_true(lit > 0, "%s lights something", fx->name);
	}
	zassert_equal(listed, 16, "16 effects offered");
}

ZTEST(effects, test_two_copies_do_not_share_state)
{
	static const struct effect *const fx[] = {
		&fx_snowfall, &fx_candle, &fx_fireworks, &fx_liquidgold, &fx_shootingstars,
		&fx_hearthfrost,
	};
	struct imu_state imu = {.ok = true, .gy = 1000};
	static struct led_rgb f2[LED_COUNT];
	static uint32_t snapshot[FX_STATE_MAX / 4];

	for (size_t e = 0; e < ARRAY_SIZE(fx); e++) {
		memset(state_a, 0, sizeof(state_a));
		memset(state_b, 0, sizeof(state_b));
		if (fx[e]->start != NULL) {
			fx[e]->start(frame, state_a);
			fx[e]->start(f2, state_b);
		}
		run(fx[e], frame, state_a, 0, 3000, &imu);
		memcpy(snapshot, state_b, sizeof(snapshot));
		/* A preview renders its own copy; the playing one must not change. */
		run(fx[e], f2, state_b, 0, 3000, &imu);
		run(fx[e], frame, state_a, 3000, 4000, &imu);
		zassert_true(memcmp(snapshot, state_b, sizeof(snapshot)) != 0 ||
			     fx[e]->state_size == 0, "%s uses its state", fx[e]->name);
		memcpy(snapshot, state_b, sizeof(snapshot));
		run(fx[e], frame, state_a, 4000, 5000, &imu);
		zassert_mem_equal(snapshot, state_b, sizeof(snapshot), "%s state isolated",
				  fx[e]->name);
	}
}

static int brightness(const struct led_rgb *f, bool (*pick)(const struct led_info *))
{
	int sum = 0, n = 0;

	for (int i = 0; i < LED_FACE_COUNT; i++) {
		if (pick(&led_layout[i])) {
			sum += f[i].r + f[i].g + f[i].b;
			n++;
		}
	}
	return n ? sum / n : 0;
}

static bool low(const struct led_info *l) { return l->y < -40; }
static bool high(const struct led_info *l) { return l->y > 40; }
static bool right(const struct led_info *l) { return l->x > 40; }
static bool left(const struct led_info *l) { return l->x < -40; }

ZTEST(effects, test_liquid_gold_follows_gravity)
{
	struct imu_state upright = {.ok = true, .gy = 1000};
	/* Turned on its side: "down" points to the star's right. */
	struct imu_state sideways = {.ok = true, .gx = -1000};

	memset(state_a, 0, sizeof(state_a));
	run(&fx_liquidgold, frame, state_a, 0, 3000, &upright);
	zassert_true(brightness(frame, low) > brightness(frame, high) + 100, "gold at the bottom");
	run(&fx_liquidgold, frame, state_a, 3000, 9000, &sideways);
	zassert_true(brightness(frame, right) > brightness(frame, left) + 100, "gold flowed right");
}

ZTEST(effects, test_hearth_and_frost_faces)
{
	struct imu_state imu = {.ok = true, .gy = 1000};
	int warm_front = 0, warm_back = 0;

	memset(state_a, 0, sizeof(state_a));
	run(&fx_hearthfrost, frame, state_a, 0, 10000, &imu);
	for (int i = 0; i < LED_FACE_COUNT; i++) {
		const struct led_rgb *b = &frame[led_layout[i].partner];

		warm_front += frame[i].r - frame[i].b;
		warm_back += b->r - b->b;
	}
	zassert_true(warm_front > 0 && warm_back < 0, "front hearth, back frost");

	run(&fx_hearthfrost, frame, state_a, 30000, 40000, &imu);
	warm_front = warm_back = 0;
	for (int i = 0; i < LED_FACE_COUNT; i++) {
		const struct led_rgb *b = &frame[led_layout[i].partner];

		warm_front += frame[i].r - frame[i].b;
		warm_back += b->r - b->b;
	}
	zassert_true(warm_front < 0 && warm_back > 0, "swapped after 30 s");
}

ZTEST(effects, test_disco_beat_and_faces)
{
	struct imu_state imu = {.ok = true, .gy = 1000};
	int on_beat = 0, before_beat = 0, differ = 0;

	/* 100 ms after a beat versus just before the next one (outside the strobe). */
	fx_disco.render(frame, 1100, &imu, state_a);
	for (int i = 0; i < LED_FACE_COUNT; i++) {
		if (led_layout[i].group == LED_GROUP_OUTLINE) {
			on_beat += frame[i].r + frame[i].g + frame[i].b;
		}
	}
	fx_disco.render(frame, 1490, &imu, state_a);
	for (int i = 0; i < LED_FACE_COUNT; i++) {
		const struct led_rgb *a = &frame[i];
		const struct led_rgb *b = &frame[led_layout[i].partner];

		if (led_layout[i].group == LED_GROUP_OUTLINE) {
			before_beat += a->r + a->g + a->b;
		}
		differ += (a->r != b->r || a->g != b->g || a->b != b->b);
	}
	zassert_true(on_beat > before_beat * 2, "the outline pulses with the beat");
	zassert_true(differ > LED_FACE_COUNT / 2, "the two faces show different colours");
}
```

## src/test_format.c
```c
/*
 * Copyright (c) 2024-2026 Tuomas Terho
 * SPDX-License-Identifier: MIT
 */

#include <string.h>
#include <zephyr/ztest.h>

#include "storage/effect_format.h"
#include "storage/zd35_nand.h"

static struct csfx_header valid(void)
{
	struct csfx_header h;

	memset(&h, 0, sizeof(h));
	memcpy(h.magic, CSFX_MAGIC, 4);
	h.version = CSFX_VERSION;
	h.led_count = LED_COUNT;
	h.frame_count = 10;
	return h;
}

ZTEST_SUITE(format, NULL, NULL, NULL, NULL, NULL);

ZTEST(format, test_sizes)
{
	zassert_equal(CSFX_FRAME_SIZE, 398);
	zassert_true(CSFX_PAGE_DATA <= NAND_PAGE_SIZE);
}

ZTEST(format, test_header_check)
{
	struct csfx_header h = valid();

	zassert_ok(csfx_header_check(&h, 100));

	h.frame_count = 101;
	zassert_equal(csfx_header_check(&h, 100), -EFBIG);

	h = valid();
	h.frame_count = 0;
	zassert_equal(csfx_header_check(&h, 100), -EINVAL);

	h = valid();
	h.magic[0] = 'X';
	zassert_equal(csfx_header_check(&h, 100), -EINVAL);

	h = valid();
	h.led_count = 131;
	zassert_equal(csfx_header_check(&h, 100), -EINVAL);

	h = valid();
	h.version = 2;
	zassert_equal(csfx_header_check(&h, 100), -EINVAL);
}

ZTEST(format, test_frame_location)
{
	uint32_t lb, page;
	uint16_t col;

	csfx_frame_location(0, &lb, &page, &col);
	zassert_true(lb == 1 && page == 0 && col == 0);
	csfx_frame_location(4, &lb, &page, &col);
	zassert_true(lb == 1 && page == 0 && col == 4 * 398);
	csfx_frame_location(5, &lb, &page, &col);
	zassert_true(lb == 1 && page == 1 && col == 0);
	csfx_frame_location(7, &lb, &page, &col);
	zassert_true(lb == 1 && page == 1 && col == 2 * 398);
	/* 64 pages * 5 frames per block. */
	csfx_frame_location(320, &lb, &page, &col);
	zassert_true(lb == 2 && page == 0 && col == 0);
}
```

## src/test_fw.c
```c
/*
 * Copyright (c) 2024-2026 Tuomas Terho
 * SPDX-License-Identifier: MIT
 */

#include <errno.h>
#include <string.h>
#include <zephyr/ztest.h>

#include "fw/fw_image.h"

#define SLOT (108 * 1024)

static void header(uint8_t *h, uint32_t img_size)
{
	memset(h, 0, FW_IMAGE_HEADER_LEN);
	/* magic 0x96f3b83d, little-endian */
	h[0] = 0x3d; h[1] = 0xb8; h[2] = 0xf3; h[3] = 0x96;
	h[8] = 0x00; h[9] = 0x02;          /* hdr_size 0x200 */
	h[10] = 0x00; h[11] = 0x00;        /* protect_tlv_size */
	h[12] = (uint8_t)img_size;
	h[13] = (uint8_t)(img_size >> 8);
	h[14] = (uint8_t)(img_size >> 16);
	h[15] = (uint8_t)(img_size >> 24);
	h[20] = 1; h[21] = 3; h[22] = 2; h[23] = 0; /* 1.3.2 */
	h[24] = 7;                         /* build 7 */
}

ZTEST(fw, test_valid_header)
{
	uint8_t h[FW_IMAGE_HEADER_LEN];
	struct fw_image_info i;

	header(h, 82000);
	zassert_ok(fw_image_parse(h, sizeof(h), SLOT, &i));
	zassert_equal(i.major, 1);
	zassert_equal(i.minor, 3);
	zassert_equal(i.revision, 2);
	zassert_equal(i.build, 7);
	zassert_equal(i.hdr_size, 0x200);
	zassert_equal(i.img_size, 82000);
}

ZTEST(fw, test_rejects_other_files)
{
	uint8_t h[FW_IMAGE_HEADER_LEN];
	struct fw_image_info i;

	header(h, 82000);
	h[0] = 'C'; /* e.g. a .csfx effect file */
	zassert_equal(fw_image_parse(h, sizeof(h), SLOT, &i), -EINVAL);
	header(h, 82000);
	zassert_equal(fw_image_parse(h, 16, SLOT, &i), -EINVAL);
	header(h, 0);
	zassert_equal(fw_image_parse(h, sizeof(h), SLOT, &i), -EINVAL);
}

ZTEST(fw, test_rejects_too_big)
{
	uint8_t h[FW_IMAGE_HEADER_LEN];
	struct fw_image_info i;

	header(h, SLOT - 0x200 - 4096);
	zassert_ok(fw_image_parse(h, sizeof(h), SLOT, &i));
	header(h, SLOT - 0x200 - 4096 + 1);
	zassert_equal(fw_image_parse(h, sizeof(h), SLOT, &i), -EFBIG);
}

ZTEST_SUITE(fw, NULL, NULL, NULL, NULL, NULL);
```

## src/test_layout.c
```c
/*
 * Copyright (c) 2024-2026 Tuomas Terho
 * SPDX-License-Identifier: MIT
 */

#include <zephyr/ztest.h>

#include "layout/led_layout.h"

ZTEST_SUITE(layout, NULL, NULL, NULL, NULL, NULL);

ZTEST(layout, test_faces_and_designators)
{
	for (int i = 0; i < LED_COUNT; i++) {
		const struct led_info *l = &led_layout[i];

		zassert_equal(l->face, i < LED_FACE_COUNT ? LED_FACE_FRONT : LED_FACE_BACK, "LED %d", i);
		zassert_equal(l->designator, (i % LED_FACE_COUNT) + 1, "LED %d", i);
		zassert_true(l->r <= LED_STAR_RADIUS_MM, "LED %d radius %d", i, l->r);
	}
}

ZTEST(layout, test_partners_are_mirrored)
{
	for (int i = 0; i < LED_COUNT; i++) {
		const struct led_info *l = &led_layout[i];
		const struct led_info *p = &led_layout[l->partner];

		zassert_not_equal(l->face, p->face, "LED %d", i);
		zassert_equal(p->partner, i, "LED %d", i);
		zassert_equal(l->x, p->x, "LED %d", i);
		zassert_equal(l->y, p->y, "LED %d", i);
		zassert_equal(l->col, p->col, "LED %d", i);
		zassert_equal(l->row, p->row, "LED %d", i);
	}
}

ZTEST(layout, test_groups)
{
	int outline = 0, inner = 0;

	for (int i = 0; i < LED_FACE_COUNT; i++) {
		if (led_layout[i].group == LED_GROUP_OUTLINE) {
			outline++;
			zassert_true(led_layout[i].step < 48);
		} else {
			inner++;
			zassert_true(led_layout[i].step < 18);
		}
		zassert_true(led_layout[i].point < 6);
	}
	zassert_equal(outline, 48);
	zassert_equal(inner, 18);
}

ZTEST(layout, test_grid_has_no_collisions)
{
	int cells = 0;

	for (int r = 0; r < LED_GRID_SIZE; r++) {
		for (int c = 0; c < LED_GRID_SIZE; c++) {
			uint8_t idx = led_grid[r][c];

			if (idx == LED_NONE) {
				continue;
			}
			cells++;
			zassert_true(idx < LED_FACE_COUNT);
			zassert_equal(led_layout[idx].col, c);
			zassert_equal(led_layout[idx].row, r);
		}
	}
	zassert_equal(cells, LED_FACE_COUNT, "every front LED has its own cell");
}

ZTEST(layout, test_index_and_parse)
{
	zassert_equal(led_layout_index(1, 1), 0);
	zassert_equal(led_layout_index(1, 32), 31);
	zassert_equal(led_layout_index(2, 5), 70);
	zassert_equal(led_layout_index(2, 66), 131);
	zassert_equal(led_layout_index(0, 1), -1);
	zassert_equal(led_layout_index(3, 1), -1);
	zassert_equal(led_layout_index(1, 0), -1);
	zassert_equal(led_layout_index(1, 67), -1);

	zassert_equal(led_layout_parse("D259"), 58);
	zassert_equal(led_layout_parse("d301"), 66);
	zassert_equal(led_layout_parse("D366"), 131);
	zassert_equal(led_layout_parse("131"), 131);
	zassert_equal(led_layout_parse("0"), 0);
	zassert_equal(led_layout_parse("D267"), -1);
	zassert_equal(led_layout_parse("D159"), -1);
	zassert_equal(led_layout_parse("132"), -1);
	zassert_equal(led_layout_parse("D25x"), -1);
	zassert_equal(led_layout_parse(""), -1);
}

ZTEST(layout, test_nearest)
{
	const struct led_info *tip = NULL;

	/* The top tip is at (0, 110). */
	for (int i = 0; i < LED_FACE_COUNT; i++) {
		if (led_layout[i].y == 110) {
			tip = &led_layout[i];
		}
	}
	zassert_not_null(tip);
	zassert_equal(led_layout_nearest(0, 108, LED_FACE_FRONT, 10), tip - led_layout);
	zassert_equal(led_layout_nearest(0, 108, LED_FACE_BACK, 10), tip->partner);
	zassert_equal(led_layout_nearest(0, 200, LED_FACE_FRONT, 10), -1);
}
```

## src/test_pair.c
```c
/*
 * Copyright (c) 2024-2026 Tuomas Terho
 * SPDX-License-Identifier: MIT
 */

#include <string.h>
#include <zephyr/ztest.h>

#include "bt/bm78_ad.h"
#include "pair/pair_logic.h"
#include "pair/sha256.h"

static void hex(const uint8_t *b, size_t n, char *out)
{
	pair_hex_encode(b, n, out);
}

ZTEST(pair, test_sha256_vectors)
{
	uint8_t d[SHA256_LEN];
	char h[2 * SHA256_LEN + 1];
	static char million[1000];

	sha256("abc", 3, d);
	hex(d, sizeof(d), h);
	zassert_str_equal(h, "ba7816bf8f01cfea414140de5dae2223b00361a396177a9cb410ff61f20015ad");

	sha256("", 0, d);
	hex(d, sizeof(d), h);
	zassert_str_equal(h, "e3b0c44298fc1c149afbf4c8996fb92427ae41e4649b934ca495991b7852b855");

	sha256("abcdbcdecdefdefgefghfghighijhijkijkljklmklmnlmnomnopnopq", 56, d);
	hex(d, sizeof(d), h);
	zassert_str_equal(h, "248d6a61d20638b8e5c026930c3e6039a33ce45964ff2167f6ecedd419db06c1");

	/* One million 'a', fed in pieces. */
	struct sha256 s;

	memset(million, 'a', sizeof(million));
	sha256_init(&s);
	for (int i = 0; i < 1000; i++) {
		sha256_update(&s, million, sizeof(million));
	}
	sha256_final(&s, d);
	hex(d, sizeof(d), h);
	zassert_str_equal(h, "cdc76e5c9914fb9281a1c7e284d73e67f1809a48a497200e046d39ccc7112cd0");
}

ZTEST(pair, test_hmac_rfc4231)
{
	uint8_t key[20];
	uint8_t d[SHA256_LEN];
	char h[2 * SHA256_LEN + 1];

	/* Test case 1, message split in two parts. */
	memset(key, 0x0b, sizeof(key));
	hmac_sha256(key, sizeof(key), "Hi ", 3, "There", 5, d);
	hex(d, sizeof(d), h);
	zassert_str_equal(h, "b0344c61d8db38535ca8afceaf0bf12b881dc200c9833da726e9376c2e32cff7");

	/* Test case 2. */
	hmac_sha256((const uint8_t *)"Jefe", 4, "what do ya want ", 16, "for nothing?", 12, d);
	hex(d, sizeof(d), h);
	zassert_str_equal(h, "5bdcc146bf60754e6a042426089575c75a003f089d2739839dec58b964ec3843");
}

/* Shared with the apps' tests: key 00..0f, nonce 10..1f. */
ZTEST(pair, test_auth_vector)
{
	uint8_t key[PAIR_KEY_LEN], nonce[PAIR_NONCE_LEN], d[SHA256_LEN];
	char h[2 * SHA256_LEN + 1];

	for (int i = 0; i < 16; i++) {
		key[i] = (uint8_t)i;
		nonce[i] = (uint8_t)(0x10 + i);
	}
	hmac_sha256(key, sizeof(key), "auth", 4, nonce, sizeof(nonce), d);
	hex(d, sizeof(d), h);
	zassert_str_equal(h, "8b9b4fe50baada231361d9491a71d3ef7ae699bc95c7366a34c5784d99370d9a");
}

ZTEST(pair, test_window_only_when_free)
{
	struct pair_logic p;

	pair_logic_init(&p, false, 1000);
	zassert_true(p.window);
	zassert_equal(pair_logic_window_left(&p, 1000), PAIR_WINDOW_MS);
	pair_logic_tick(&p, 1000 + PAIR_WINDOW_MS, false);
	zassert_false(p.window);

	pair_logic_init(&p, true, 1000);
	zassert_false(p.window);
}

ZTEST(pair, test_shake_opens_window)
{
	struct pair_logic p;
	bool opened = false;
	int64_t t = 0;

	pair_logic_init(&p, true, 0);
	/* 4.9 s of shaking with short pauses: not yet. */
	for (t = 0; t < 4900; t += 20) {
		bool pause = (t % 1000) > 800 && (t % 1000) < 1000;

		opened |= pair_logic_tick(&p, t, !pause);
	}
	zassert_false(opened);
	for (; t <= 5100 && !opened; t += 20) {
		opened = pair_logic_tick(&p, t, true);
	}
	zassert_true(opened);
	zassert_true(p.window);
}

ZTEST(pair, test_long_pause_restarts_shake)
{
	struct pair_logic p;
	bool opened = false;

	pair_logic_init(&p, true, 0);
	for (int64_t t = 0; t < 3000; t += 20) {
		opened |= pair_logic_tick(&p, t, true);
	}
	/* 400 ms still: the count starts again. */
	for (int64_t t = 3000; t < 3400; t += 20) {
		opened |= pair_logic_tick(&p, t, false);
	}
	for (int64_t t = 3400; t < 6000; t += 20) {
		opened |= pair_logic_tick(&p, t, true);
	}
	zassert_false(opened);
}

ZTEST(pair, test_pair_and_release)
{
	struct pair_logic p;

	pair_logic_init(&p, false, 0);
	pair_logic_paired(&p);
	zassert_true(p.owned);
	zassert_false(p.window);
	pair_logic_released(&p);
	zassert_false(p.owned);
	/* No window until the next power-on (or shaking). */
	zassert_false(p.window);
}

ZTEST(pair, test_locked_parser)
{
	char l[100];
	const char *arg;

	strcpy(l, "app hello");
	zassert_equal(pair_parse_locked(l, &arg), LOCKED_HELLO);
	strcpy(l, "  app   hello  ");
	zassert_equal(pair_parse_locked(l, &arg), LOCKED_HELLO);
	strcpy(l, "");
	zassert_equal(pair_parse_locked(l, &arg), LOCKED_NONE);
	strcpy(l, "help");
	zassert_equal(pair_parse_locked(l, &arg), LOCKED_HELP);
	strcpy(l, "led status");
	zassert_equal(pair_parse_locked(l, &arg), LOCKED_DENIED);
	strcpy(l, "app state");
	zassert_equal(pair_parse_locked(l, &arg), LOCKED_DENIED);
	strcpy(l, "app pair 000102030405060708090a0b0c0d0e0f");
	zassert_equal(pair_parse_locked(l, &arg), LOCKED_PAIR);
	zassert_str_equal(arg, "000102030405060708090a0b0c0d0e0f");
	strcpy(l, "app pair 0001");
	zassert_equal(pair_parse_locked(l, &arg), LOCKED_DENIED);
	strcpy(l, "app auth 000102030405060708090a0b0c0d0e0f000102030405060708090a0b0c0d0e0f");
	zassert_equal(pair_parse_locked(l, &arg), LOCKED_AUTH);
	strcpy(l, "app hello extra");
	zassert_equal(pair_parse_locked(l, &arg), LOCKED_DENIED);
}

ZTEST(pair, test_hex)
{
	uint8_t b[4];

	zassert_ok(pair_hex_decode("00aBff10", b, 4));
	zassert_equal(b[1], 0xab);
	zassert_equal(b[2], 0xff);
	zassert_not_ok(pair_hex_decode("00ab", b, 4));
	zassert_not_ok(pair_hex_decode("00ag", b, 2));
	zassert_true(pair_equal((const uint8_t *)"abc", (const uint8_t *)"abc", 3));
	zassert_false(pair_equal((const uint8_t *)"abc", (const uint8_t *)"abd", 3));
}

/* The factory data of the BM78 on the second prototype board. */
static const uint8_t factory_adv[BM78_AD_BLOCK] = {
	0x0d, 0x09, 0x09, 'D', 'u', 'a', 'l', '-', 'S', 'P', 'P', 0x02, 0x01, 0x02,
};
static const uint8_t factory_scan[BM78_AD_BLOCK] = {0x03, 0x02, 0x0a, 0x02};

ZTEST(pair, test_ad_rename)
{
	uint8_t b[BM78_AD_BLOCK];
	static const uint8_t want[BM78_AD_BLOCK] = {
		0x0e, 0x0a, 0x09, 'S', 't', 'a', 'r', '-', 'A', 'E', '9', '4', 0x02, 0x01, 0x02,
	};

	memcpy(b, factory_adv, sizeof(b));
	zassert_ok(bm78_ad_set_name(b, "Star-AE94"));
	zassert_mem_equal(b, want, sizeof(want));

	zassert_ok(bm78_ad_set_name(b, "Sixteen chars!!!"));
	zassert_equal(b[0], 2 + 16 + 3);
	zassert_not_ok(bm78_ad_set_name(b, "Seventeen chars!!"));
	zassert_not_ok(bm78_ad_set_name(b, ""));

	memcpy(b, factory_adv, sizeof(b));
	b[0] = 40;
	zassert_not_ok(bm78_ad_set_name(b, "x"));
}

ZTEST(pair, test_ad_service)
{
	uint8_t b[BM78_AD_BLOCK];

	memcpy(b, factory_scan, sizeof(b));
	zassert_equal(bm78_ad_add_service(b), 1);
	zassert_equal(b[0], 18 + 3);
	zassert_equal(b[1], 17);
	zassert_equal(b[2], 0x07);
	zassert_equal(b[3], 0x55);
	zassert_equal(b[18], 0x49);
	zassert_equal(b[19], 0x02);
	zassert_equal(b[20], 0x0a);
	/* Already there: unchanged. */
	zassert_equal(bm78_ad_add_service(b), 0);
	zassert_equal(b[0], 18 + 3);
}

ZTEST(pair, test_default_name)
{
	static const uint8_t addr[6] = {0x94, 0xae, 0x52, 0x32, 0x84, 0x40};
	char n[BM78_NAME_MAX + 1];

	bm78_default_name(addr, n);
	zassert_str_equal(n, "Star-AE94");
}

ZTEST_SUITE(pair, NULL, NULL, NULL, NULL, NULL);
```

## src/test_parse.c
```c
/*
 * Copyright (c) 2024-2026 Tuomas Terho
 * SPDX-License-Identifier: MIT
 */

#include <zephyr/ztest.h>

#include "cli/direct_parse.h"
#include "led/color.h"
#include "led/led_chain.h"

ZTEST_SUITE(parse, NULL, NULL, NULL, NULL, NULL);

ZTEST(parse, test_color_formats)
{
	struct led_rgb c;

	zassert_ok(color_parse("0xffee33", &c));
	zassert_true(c.r == 0xff && c.g == 0xee && c.b == 0x33);
	zassert_ok(color_parse("#0000FF", &c));
	zassert_true(c.r == 0 && c.g == 0 && c.b == 0xff);
	zassert_ok(color_parse("102030", &c));
	zassert_true(c.r == 0x10 && c.g == 0x20 && c.b == 0x30);
	zassert_ok(color_parse("0X0a0B0c", &c));
	zassert_true(c.r == 0x0a && c.g == 0x0b && c.b == 0x0c);

	zassert_equal(color_parse("0xffee3", &c), -EINVAL);
	zassert_equal(color_parse("0xffee333", &c), -EINVAL);
	zassert_equal(color_parse("zz0000", &c), -EINVAL);
	zassert_equal(color_parse("", &c), -EINVAL);
	zassert_equal(color_parse("#", &c), -EINVAL);
	zassert_equal(color_parse(NULL, &c), -EINVAL);
}

ZTEST(parse, test_side_and_index)
{
	int first, last;

	zassert_equal(direct_parse_side("0"), 0);
	zassert_equal(direct_parse_side("1"), 1);
	zassert_equal(direct_parse_side("2"), 2);
	zassert_equal(direct_parse_side("3"), -1);
	zassert_equal(direct_parse_side("-1"), -1);
	zassert_equal(direct_parse_side("a"), -1);
	zassert_equal(direct_parse_side(""), -1);

	zassert_equal(direct_parse_index("1"), 1);
	zassert_equal(direct_parse_index("32"), 32);
	zassert_equal(direct_parse_index("66"), 66);
	zassert_equal(direct_parse_index("0"), -1);
	zassert_equal(direct_parse_index("67"), -1);
	zassert_equal(direct_parse_index("3x"), -1);

	direct_side_range(1, &first, &last);
	zassert_true(first == 0 && last == 65);
	direct_side_range(2, &first, &last);
	zassert_true(first == 66 && last == 131);
	direct_side_range(0, &first, &last);
	zassert_true(first == 0 && last == 131);
}

ZTEST(parse, test_current_limit_scale)
{
	/* 132 LEDs full white, 12 mA per channel = 4752 mA. */
	uint32_t full = 132U * 3U * 255U;

	zassert_equal(led_chain_limit_scale(full, 12, 0), 256, "limit off");
	zassert_equal(led_chain_limit_scale(full, 12, 5000), 256, "under limit");
	zassert_equal(led_chain_limit_scale(full, 12, 2000), 2000U * 256U / 4752U);
	zassert_equal(led_chain_limit_scale(0, 12, 2000), 256);
}

ZTEST(parse, test_hsv)
{
	struct led_rgb c = color_hsv(0, 255, 255);

	zassert_true(c.r == 255 && c.b == 0);
	c = color_hsv(0, 0, 200);
	zassert_true(c.r == c.g && c.g == c.b);
}
```

## src/test_stream.c
```c
/*
 * Copyright (c) 2024-2026 Tuomas Terho
 * SPDX-License-Identifier: MIT
 */

#include <string.h>
#include <zephyr/ztest.h>

#include "transfer/stream_frame.h"
#include "transfer/xmodem.h"

static struct stream_rx rx;
static uint8_t buf[4 + 2 * LED_COUNT + 2];

/* Build a frame the way the Android app does. */
static size_t make_frame(uint8_t flags, uint8_t n, uint8_t fill)
{
	size_t len = 0;

	buf[len++] = STREAM_SYNC0;
	buf[len++] = STREAM_SYNC1;
	buf[len++] = flags;
	buf[len++] = n;
	for (int i = 0; i < 2 * n; i++) {
		buf[len++] = (uint8_t)(fill + i);
	}
	uint16_t crc = xmodem_crc16(&buf[2], len - 2);

	buf[len++] = (uint8_t)(crc >> 8);
	buf[len++] = (uint8_t)crc;
	return len;
}

static enum stream_event feed_all(size_t len)
{
	enum stream_event ev = STREAM_NONE;

	for (size_t i = 0; i < len; i++) {
		enum stream_event e = stream_rx_feed(&rx, buf[i]);

		if (e != STREAM_NONE) {
			ev = e;
		}
	}
	return ev;
}

static void reset(void *f)
{
	ARG_UNUSED(f);
	stream_rx_init(&rx);
}

ZTEST_SUITE(stream, NULL, NULL, reset, NULL, NULL);

ZTEST(stream, test_front_copy_frame)
{
	size_t len = make_frame(STREAM_FLAG_BACK_COPY, LED_FACE_COUNT, 7);

	zassert_equal(feed_all(len), STREAM_FRAME);
	zassert_equal(rx.count, LED_FACE_COUNT);
	zassert_equal(rx.flags, STREAM_FLAG_BACK_COPY);
	zassert_equal(rx.payload[0], 7);
	zassert_equal(rx.payload[2 * LED_FACE_COUNT - 1], (uint8_t)(7 + 2 * LED_FACE_COUNT - 1));
}

ZTEST(stream, test_full_frame_and_resync_after_garbage)
{
	size_t len = make_frame(0, LED_COUNT, 1);
	uint8_t junk[] = {'s', 't', 'a', 'r', ':', 0xA5, 0x00};

	for (size_t i = 0; i < sizeof(junk); i++) {
		zassert_equal(stream_rx_feed(&rx, junk[i]), STREAM_NONE);
	}
	zassert_equal(feed_all(len), STREAM_FRAME);
	zassert_equal(rx.count, LED_COUNT);
}

ZTEST(stream, test_bad_crc_and_oversize)
{
	size_t len = make_frame(0, 10, 0);

	buf[6] ^= 0x40;
	zassert_equal(feed_all(len), STREAM_BAD);

	/* 67 LEDs in back-copy mode is invalid. */
	stream_rx_init(&rx);
	uint8_t hdr[] = {STREAM_SYNC0, STREAM_SYNC1, STREAM_FLAG_BACK_COPY, LED_FACE_COUNT + 1};
	enum stream_event ev = STREAM_NONE;

	for (size_t i = 0; i < sizeof(hdr); i++) {
		ev = stream_rx_feed(&rx, hdr[i]);
	}
	zassert_equal(ev, STREAM_BAD);
}

ZTEST(stream, test_end_frame_without_payload)
{
	size_t len = make_frame(STREAM_FLAG_END, 0, 0);

	zassert_equal(feed_all(len), STREAM_FRAME);
	zassert_equal(rx.count, 0);
	zassert_true(rx.flags & STREAM_FLAG_END);
}
```

## src/test_supply.c
```c
/*
 * Copyright (c) 2024-2026 Tuomas Terho
 * SPDX-License-Identifier: MIT
 */

#include <zephyr/ztest.h>

#include "led/led_chain.h"

ZTEST(supply, test_no_sag_keeps_limit)
{
	struct supply_limiter s;

	supply_limiter_init(&s, 600);
	for (int i = 0; i < 5000; i++) {
		zassert_false(supply_limiter_update(&s, 3320, 550, 600));
	}
	zassert_equal(s.limit_ma, 600);
	zassert_equal(s.sags, 0);
}

ZTEST(supply, test_sag_cuts_below_drawn_current)
{
	struct supply_limiter s;

	supply_limiter_init(&s, 2000);
	/* Mild sag while drawing 800 mA: limit 7/8 of 800. */
	zassert_false(supply_limiter_update(&s, 3150, 800, 2000));
	zassert_equal(s.limit_ma, 700);
	/* Deep sag: half of what is left. */
	zassert_true(supply_limiter_update(&s, 2700, 700, 2000));
	zassert_equal(s.limit_ma, 350);
	zassert_equal(s.sags, 2);
	zassert_equal(s.deep_sags, 1);
}

ZTEST(supply, test_floor_and_configured_max)
{
	struct supply_limiter s;

	supply_limiter_init(&s, 600);
	for (int i = 0; i < 20; i++) {
		(void)supply_limiter_update(&s, 2500, 0, 600);
	}
	zassert_equal(s.limit_ma, SUPPLY_LIMIT_FLOOR_MA);
	/* Lowering the configured limit applies at once. */
	supply_limiter_init(&s, 600);
	(void)supply_limiter_update(&s, 3320, 0, 300);
	zassert_equal(s.limit_ma, 300);
	/* 0 = off: ceiling only. */
	supply_limiter_init(&s, 0);
	(void)supply_limiter_update(&s, 3320, 0, 0);
	zassert_equal(s.limit_ma, SUPPLY_LIMIT_CEILING_MA);
}

ZTEST(supply, test_slow_recovery)
{
	struct supply_limiter s;

	supply_limiter_init(&s, 600);
	(void)supply_limiter_update(&s, 3100, 600, 600);
	zassert_equal(s.limit_ma, 525);
	/* Between the thresholds the calm period does not advance. */
	for (int i = 0; i < 2 * SUPPLY_CALM_FRAMES; i++) {
		(void)supply_limiter_update(&s, 3230, 500, 600);
	}
	zassert_equal(s.calm_frames, 0);
	/* Nothing during the calm period. */
	for (int i = 0; i < SUPPLY_CALM_FRAMES; i++) {
		(void)supply_limiter_update(&s, 3320, 500, 600);
	}
	zassert_equal(s.limit_ma, 525);
	/* Then 1 mA per ~11 frames, never above the configured limit. */
	for (int i = 0; i < 110; i++) {
		(void)supply_limiter_update(&s, 3320, 500, 600);
	}
	zassert_true(s.limit_ma >= 530 && s.limit_ma <= 536, "limit %u", s.limit_ma);
	for (int i = 0; i < 5000; i++) {
		(void)supply_limiter_update(&s, 3320, 500, 600);
	}
	zassert_equal(s.limit_ma, 600);
}

ZTEST_SUITE(supply, NULL, NULL, NULL, NULL, NULL);
```

## src/test_xmodem.c
```c
/*
 * Copyright (c) 2024-2026 Tuomas Terho
 * SPDX-License-Identifier: MIT
 */

#include <string.h>
#include <zephyr/ztest.h>

#include "transfer/xmodem.h"

static uint8_t sent[64];
static size_t sent_len;
static uint8_t sink_buf[2048];
static size_t sink_len;
static int sink_ret;
static struct xmodem_rx x;
static uint8_t pkt[1029];

static void send(void *ctx, uint8_t c)
{
	ARG_UNUSED(ctx);
	if (sent_len < sizeof(sent)) {
		sent[sent_len++] = c;
	}
}

static int sink(void *ctx, const uint8_t *data, size_t len)
{
	ARG_UNUSED(ctx);
	if (sink_ret != 0) {
		return sink_ret;
	}
	zassert_true(sink_len + len <= sizeof(sink_buf));
	memcpy(&sink_buf[sink_len], data, len);
	sink_len += len;
	return 0;
}

static size_t make_packet(uint8_t blk, size_t size, uint8_t fill)
{
	pkt[0] = size == 128 ? XMODEM_SOH : XMODEM_STX;
	pkt[1] = blk;
	pkt[2] = (uint8_t)~blk;
	for (size_t i = 0; i < size; i++) {
		pkt[3 + i] = (uint8_t)(fill + i);
	}
	uint16_t crc = xmodem_crc16(&pkt[3], size);

	pkt[3 + size] = (uint8_t)(crc >> 8);
	pkt[4 + size] = (uint8_t)crc;
	return size + 5;
}

static uint8_t last_sent(void)
{
	return sent_len ? sent[sent_len - 1] : 0;
}

static void reset(void *f)
{
	ARG_UNUSED(f);
	sent_len = 0;
	sink_len = 0;
	sink_ret = 0;
	xmodem_rx_start(&x, send, sink, NULL);
}

ZTEST_SUITE(xmodem, NULL, NULL, reset, NULL, NULL);

ZTEST(xmodem, test_crc16_reference)
{
	/* CRC-16/XMODEM check value for "123456789". */
	zassert_equal(xmodem_crc16((const uint8_t *)"123456789", 9), 0x31C3);
}

ZTEST(xmodem, test_requests_crc_mode)
{
	zassert_equal(sent_len, 1);
	zassert_equal(sent[0], XMODEM_CRC_REQ);
}

ZTEST(xmodem, test_two_blocks_and_eot)
{
	size_t n = make_packet(1, 128, 0x10);

	zassert_equal(xmodem_rx_feed(&x, pkt, n), XMODEM_RUNNING);
	zassert_equal(last_sent(), XMODEM_ACK);

	n = make_packet(2, 1024, 0x40);
	/* Deliver in odd-sized pieces. */
	for (size_t i = 0; i < n; i += 37) {
		xmodem_rx_feed(&x, &pkt[i], MIN(37, n - i));
	}
	zassert_equal(last_sent(), XMODEM_ACK);
	zassert_equal(sink_len, 128 + 1024);
	zassert_equal(sink_buf[0], 0x10);
	zassert_equal(sink_buf[128], 0x40);

	uint8_t eot = XMODEM_EOT;

	zassert_equal(xmodem_rx_feed(&x, &eot, 1), XMODEM_DONE);
	zassert_equal(last_sent(), XMODEM_ACK);
}

ZTEST(xmodem, test_bad_crc_is_nakked_then_accepted)
{
	size_t n = make_packet(1, 128, 0);

	pkt[10] ^= 0xFF;
	xmodem_rx_feed(&x, pkt, n);
	/* Before the first good block, the receiver keeps asking with 'C'. */
	zassert_equal(last_sent(), XMODEM_CRC_REQ);
	zassert_equal(sink_len, 0);

	n = make_packet(1, 128, 0);
	xmodem_rx_feed(&x, pkt, n);
	zassert_equal(last_sent(), XMODEM_ACK);

	n = make_packet(2, 128, 0);
	pkt[n - 1] ^= 1;
	xmodem_rx_feed(&x, pkt, n);
	zassert_equal(last_sent(), XMODEM_NAK);
	zassert_equal(sink_len, 128);
}

ZTEST(xmodem, test_duplicate_block_not_written_twice)
{
	size_t n = make_packet(1, 128, 0);

	xmodem_rx_feed(&x, pkt, n);
	xmodem_rx_feed(&x, pkt, n);
	zassert_equal(last_sent(), XMODEM_ACK);
	zassert_equal(sink_len, 128);
}

ZTEST(xmodem, test_out_of_sequence_fails)
{
	size_t n = make_packet(3, 128, 0);

	zassert_equal(xmodem_rx_feed(&x, pkt, n), XMODEM_FAILED);
	zassert_equal(last_sent(), XMODEM_CAN);
}

ZTEST(xmodem, test_sink_error_cancels)
{
	size_t n = make_packet(1, 128, 0);

	sink_ret = -EFBIG;
	zassert_equal(xmodem_rx_feed(&x, pkt, n), XMODEM_FAILED);
	zassert_equal(x.sink_error, -EFBIG);
	zassert_equal(last_sent(), XMODEM_CAN);
}

ZTEST(xmodem, test_sender_cancel)
{
	uint8_t can[2] = {XMODEM_CAN, XMODEM_CAN};

	zassert_equal(xmodem_rx_feed(&x, can, 2), XMODEM_CANCELLED);
}

ZTEST(xmodem, test_start_timeout)
{
	enum xmodem_result r = XMODEM_RUNNING;
	int ticks = 0;

	while (r == XMODEM_RUNNING && ticks < 100) {
		r = xmodem_rx_tick(&x);
		ticks++;
	}
	zassert_equal(r, XMODEM_FAILED);
	zassert_true(ticks >= XMODEM_START_TRIES - 1);
}

ZTEST(xmodem, test_eot_before_data_fails)
{
	uint8_t eot = XMODEM_EOT;

	zassert_equal(xmodem_rx_feed(&x, &eot, 1), XMODEM_FAILED);
}
```
